## config/boards/shields/usb_smoke/Kconfig.defconfig
```kconfig
# SPDX-License-Identifier: MIT

if SHIELD_USB_SMOKE

config ZMK_KEYBOARD_NAME
    default "USB Smoke"

config ZMK_KSCAN_MOCK_DRIVER
    default y

endif
```

## config/boards/shields/usb_smoke/Kconfig.shield
```kconfig
# SPDX-License-Identifier: MIT

config SHIELD_USB_SMOKE
    def_bool $(shields_list_contains,usb_smoke)
```

## config/west.yml
```yaml
manifest:
  remotes:
    - name: zmkfirmware
      url-base: https://github.com/zmkfirmware
    - name: jun-design-sketch
      url-base: https://github.com/Jun-design-sketch
  projects:
    - name: zmk
      remote: zmkfirmware
      revision: v0.3.0
      import: app/west.yml
    - name: zmk-dongle-screen
      remote: jun-design-sketch
      revision: 680e6892a98c5702cd1514f1cabbc17675cbd664 # Bright layer and battery palette
  self:
    path: config
```
